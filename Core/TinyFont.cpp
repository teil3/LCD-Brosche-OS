#include "TinyFont.h"

#include <pgmspace.h>

namespace TinyFont {
namespace {
// 5x7 font, ASCII 32..127 (from classic ASCII font)
constexpr uint8_t glyphs[][5] PROGMEM = {
    {0x00,0x00,0x00,0x00,0x00}, // 32 ' '
    {0x00,0x00,0x5F,0x00,0x00}, // 33 '!'
    {0x00,0x07,0x00,0x07,0x00}, // 34 '"'
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    {0x7F,0x7F,0x7F,0x7F,0x7F}  // 127 DEL -> block
};

constexpr uint8_t glyphCount = sizeof(glyphs) / sizeof(glyphs[0]);

void drawChar(TFT_eSPI& tft, int16_t x, int16_t y, char c, uint16_t fg,
              uint8_t scale) {
  uint8_t code = static_cast<uint8_t>(c);
  if (code < 32 || code >= 32 + glyphCount) {
    code = '?';
  }
  const uint8_t* columns = glyphs[code - 32];
  for (uint8_t cx = 0; cx < kGlyphW; ++cx) {
    uint8_t line = pgm_read_byte(&columns[cx]);
    for (uint8_t cy = 0; cy < kGlyphH; ++cy) {
      if (line & (1 << cy)) {
        tft.fillRect(x + cx * scale, y + cy * scale, scale, scale, fg);
      }
    }
  }
}

}  // namespace

uint16_t measure(const String& text, uint8_t scale) {
  if (text.length() == 0) return 0;
  uint16_t width = 0;
  for (size_t i = 0; i < text.length(); ++i) {
    char c = text[i];
    if (c == '\n') continue;  // no multiline support
    width += (kGlyphW + 1) * scale;
  }
  if (width > 0) width -= scale; // remove last spacing
  return width;
}

uint16_t glyphHeight(uint8_t scale) { return kGlyphH * scale; }

void drawString(TFT_eSPI& tft, int16_t x, int16_t y, const String& text,
                uint16_t fg, uint8_t scale) {
  int16_t cursorX = x;
  for (size_t i = 0; i < text.length(); ++i) {
    char c = text[i];
    if (c == '\n') continue;
    drawChar(tft, cursorX, y, c, fg, scale);
    cursorX += (kGlyphW + 1) * scale;
  }
}

void drawStringCentered(TFT_eSPI& tft, int16_t y, const String& text,
                        uint16_t fg, uint8_t scale) {
  uint16_t w = measure(text, scale);
  int16_t x = (tft.width() - w) / 2;
  if (x < 0) x = 0;
  drawString(tft, x, y, text, fg, scale);
}

void drawStringOutline(TFT_eSPI& tft, int16_t x, int16_t y, const String& text,
                       uint16_t fg, uint16_t outline, uint8_t scale) {
  static const int8_t offsets[8][2] = {
      {-1, 0}, {1, 0}, {0, -1}, {0, 1}, {-1, -1}, {-1, 1}, {1, -1}, {1, 1}};
  for (const auto& off : offsets) {
    drawString(tft, x + off[0] * scale, y + off[1] * scale, text, outline, scale);
  }
  drawString(tft, x, y, text, fg, scale);
}

void drawStringOutlineCentered(TFT_eSPI& tft, int16_t y, const String& text,
                               uint16_t fg, uint16_t outline, uint8_t scale) {
  uint16_t w = measure(text, scale);
  int16_t x = (tft.width() - w) / 2;
  if (x < 0) x = 0;
  drawStringOutline(tft, x, y, text, fg, outline, scale);
}

}  // namespace TinyFont
